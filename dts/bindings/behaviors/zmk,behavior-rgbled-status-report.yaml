## dts/bindings/behaviors/zmk,behavior-rgbled-status-report.yaml
```yaml
description: RGB LED Status Report Behavior

compatible: "zmk,behavior-rgbled-status-report"

properties:
  "#binding-cells":
    type: int
    required: true
    const: 0
```
